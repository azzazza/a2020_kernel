/* Copyright (c) 2014, The Linux Foundation. All rights reserved.
 *
 * This program is free software; you can redistribute it and/or modify
 * it under the terms of the GNU General Public License version 2 and
 * only version 2 as published by the Free Software Foundation.
 *
 * This program is distributed in the hope that it will be useful,
 * but WITHOUT ANY WARRANTY; without even the implied warranty of
 * MERCHANTABILITY or FITNESS FOR A PARTICULAR PURPOSE.  See the
 * GNU General Public License for more details.
 */

/*---------------------------------------------------------------------------
 * This file is autogenerated file using gcdb parser. Please do not edit it.
 * Update input XML file to add a new entry or update variable in this file
 * VERSION = "1.0"
 *---------------------------------------------------------------------------*/
&mdss_mdp {
	dsi_hx8379c_fwvga_baolongda_video: qcom,mdss_dsi_hx8379c_fwvga_baolongda_video {
		qcom,mdss-dsi-panel-name = "hx8379c fwvga baolongda video mode dsi panel";
		qcom,mdss-dsi-panel-controller = <&mdss_dsi0>;
		qcom,mdss-dsi-panel-type = "dsi_video_mode";
		qcom,mdss-dsi-panel-destination = "display_1";
		qcom,mdss-dsi-panel-framerate = <60>;
		qcom,mdss-dsi-virtual-channel-id = <0>;
		qcom,mdss-dsi-stream = <0>;
		qcom,mdss-dsi-panel-width = <480>;
		qcom,mdss-dsi-panel-height = <854>;
		qcom,mdss-dsi-h-front-porch = <60>;
		qcom,mdss-dsi-h-back-porch = <94>;
		qcom,mdss-dsi-h-pulse-width = <40>;
		qcom,mdss-dsi-h-sync-skew = <0>;
		qcom,mdss-dsi-v-back-porch = <6>;
		qcom,mdss-dsi-v-front-porch = <6>;
		qcom,mdss-dsi-v-pulse-width = <5>;
		qcom,mdss-dsi-h-left-border = <0>;
		qcom,mdss-dsi-h-right-border = <0>;
		qcom,mdss-dsi-v-top-border = <0>;
		qcom,mdss-dsi-v-bottom-border = <0>;
		qcom,mdss-dsi-bpp = <24>;
		qcom,mdss-dsi-color-order = <0>;
		qcom,mdss-dsi-underflow-color = <0xff>;
		qcom,mdss-dsi-border-color = <0>;
		qcom,mdss-dsi-on-command = [
		39 01 00 00 00 00 04 B9 FF 83 79 
		39 01 00 00 00 00 11 B1 64 14 14 31
						31 90 D0 Ec 9e
						80 38 38 F8 22
						22 22
		39 01 00 00 00 00 0A B2 82 FE 0b 04 00 50 11 42 1D
		39 01 00 00 00 00 0B B4 84 6e 6e 6e 6e 6e 22 86 23 86
		39 01 00 00 00 00 02 CC 02
		39 01 00 00 00 00 02 D2 00
		39 01 00 00 00 00 1e D3 00 07 00 00
						00 0e 0e 32 10
						04 00 02 03 6e 
						03 6e 00 06 00
						06 21 22 05 03
						23 05 05 23 09
		39 01 00 00 00 00 23 D5 18 18 19 19
						01 00 03 02 21
						20 18 18 18 18
						18 18 18 18 18 
						18 18 18 18 18
						18 18 18 18 18
						18 18 18 00 00
		39 01 00 00 00 00 21 D6 18 18 18 18 
						02 03 00 01 20
						21 19 19 18 18
						18 18 18 18 18 
						18 18 18 18 18
						18 18 18 18 18 
						18 18 18
		39 01 00 00 00 00 2B E0 00 0d 1c 17
						18 3f 30 3d 09
						0d 0e 18 10 16
						18 15 15 08 14
						14 18 00 0d 1c
						17 18 3f 30 3d 
						09 0d 0e 18 10
						16 18 15 15 08
						14 14 18
		39 01 00 00 00 00 05 c7 00 00 00 c0
		39 01 00 00 00 00 03 B6 62 62
		05 01 00 00 78 00 02 11 00		
		05 01 00 00 14 00 02 29 00
			];
		qcom,mdss-dsi-off-command = [05 01 00 00 32 00 02 28 00
			05 01 00 00 78 00 02 10 00];
		qcom,mdss-dsi-on-command-state = "dsi_lp_mode";
		qcom,mdss-dsi-off-command-state = "dsi_hs_mode";
		//qcom,mdss-dsi-panel-status-check-mode = "bta_check";
		qcom,mdss-dsi-h-sync-pulse = <1>;
		qcom,mdss-dsi-traffic-mode = "burst_mode";
		qcom,mdss-dsi-bllp-eof-power-mode;
		qcom,mdss-dsi-bllp-power-mode;
		qcom,mdss-dsi-hfp-power-mode;
		qcom,mdss-dsi-hbp-power-mode;
		qcom,mdss-dsi-hsa-power-mode;		
		qcom,mdss-dsi-lane-0-state;
		qcom,mdss-dsi-lane-1-state;
		qcom,mdss-dsi-panel-timings = [79 1a 12 00 3e 42 16 1e 15 03 04 00];
		qcom,mdss-dsi-t-clk-post = <0x04>;
		qcom,mdss-dsi-t-clk-pre = < 0x1a>;
		qcom,mdss-dsi-bl-min-level = <1>;
		qcom,mdss-dsi-bl-max-level = <255>;
		qcom,mdss-dsi-bl-pmic-control-type = "bl_ctrl_pwm";
		qcom,mdss-dsi-bl-pmic-pwm-frequency = <100>;
		qcom,mdss-dsi-bl-pmic-bank-select = <0>;
		qcom,mdss-dsi-pwm-gpio = <&pm8909_mpps 2 0>;
		qcom,mdss-dsi-dma-trigger = "trigger_sw";
		qcom,mdss-dsi-mdp-trigger = "none";
		qcom,mdss-dsi-reset-sequence = <1 02>, <0 10>, <1 100>;
		qcom,mdss-dsi-post-init-delay = <4>;
		qcom,cont-splash-enabled;
		qcom,mdss-pan-physical-width-dimension = <62>;
		qcom,mdss-pan-physical-height-dimension = <110>;
	};
};
