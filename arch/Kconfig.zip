## drivers/input/touchscreen/msg2238/Kconfig
```kconfig
#
# Mstar msg2238 touchscreen driver configuration
#
menuconfig TOUCHSCREEN_MSG2238
	bool "Mstar msg2238 touchscreen"
	default y
	help
	  Say Y here if you have a Mstar msg2238 touchscreen connected
	  to your system.

	  If unsure, say N.
if TOUCHSCREEN_MSG2238

config TOUCHSCREEN_MSTAR_DRV_COMMON_MSG2238
	tristate "Mstar msg2238 core driver module"
	help
	  Say Y here to enable basic touch reporting functionalities.

	  If unsure, say N.

	  To compile this driver as a module, choose M here: the
	  module will be called synaptics_dsx_core.

config TOUCHSCREEN_MSTAR_DRV_IC_FW_PORTING_LAYER_MSG2238
	tristate "Mstar msg2238 core driver module"
	help
	  Say Y here to enable basic touch reporting functionalities.

	  If unsure, say N.

	  To compile this driver as a module, choose M here: the
	  module will be called synaptics_dsx_core.

config TOUCHSCREEN_MSTAR_DRV_QCOM_MSG2238
	tristate "Mstar msg2238 core driver module"
	help
	  Say Y here to enable basic touch reporting functionalities.

	  If unsure, say N.

	  To compile this driver as a module, choose M here: the
	  module will be called synaptics_dsx_core.

config TOUCHSCREEN_MSTAR_DRV_SELF_FW_CONTROL_MSG2238
	tristate "Mstar msg2238 core driver module"
	help
	  Say Y here to enable basic touch reporting functionalities.

	  If unsure, say N.

	  To compile this driver as a module, choose M here: the
	  module will be called synaptics_dsx_core.

config TOUCHSCREEN_MSTAR_DRV_UPDATE_FW_CONTROL_MSG2238
	tristate "Mstar msg2238 core driver module"
	help
	  Say Y here to enable basic touch reporting functionalities.

	  If unsure, say N.

	  To compile this driver as a module, choose M here: the
	  module will be called synaptics_dsx_core.

config TOUCHSCREEN_MSTAR_DRV_SELF_MP_TEST_MSG2238
	tristate "Mstar msg2238 core driver module"
	help
	  Say Y here to enable basic touch reporting functionalities.

	  If unsure, say N.

	  To compile this driver as a module, choose M here: the
	  module will be called synaptics_dsx_core.

config TOUCHSCREEN_MSTAR_DRV_UTILITY_ADAPTION_MSG2238
	tristate "Mstar msg2238 core driver module"
	help
	  Say Y here to enable basic touch reporting functionalities.

	  If unsure, say N.

	  To compile this driver as a module, choose M here: the
	  module will be called synaptics_dsx_core.

config TOUCHSCREEN_MSTAR_DRV_PLATFORM_INTERFACE_MSG2238
	tristate "Mstar msg2238 core driver module"
	help
	  Say Y here to enable basic touch reporting functionalities.

	  If unsure, say N.

	  To compile this driver as a module, choose M here: the
	  module will be called synaptics_dsx_core.	  

config TOUCHSCREEN_MSTAR_DRV_PLATFORM_PORTING_LAYER_MSG2238
	tristate "Mstar msg2238 core driver module"
	help
	  Say Y here to enable basic touch reporting functionalities.

	  If unsure, say N.

	  To compile this driver as a module, choose M here: the
	  module will be called synaptics_dsx_core.	  	
	  
config TOUCHSCREEN_MSTAR_DRV_MAIN_MSG2238
	tristate "Mstar msg2238 core driver module"
	help
	  Say Y here to enable basic touch reporting functionalities.

	  If unsure, say N.

	  To compile this driver as a module, choose M here: the
	  module will be called synaptics_dsx_core.	 	  

endif
```
